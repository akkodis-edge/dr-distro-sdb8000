## conf/bblayers.conf.sample
```bitbake
# LAYER_CONF_VERSION is increased each time build/conf/bblayers.conf
# changes incompatibly
LCONF_VERSION = "7"

BBPATH = "${TOPDIR}"
BBFILES ?= ""

BBLAYERS ?= " \
  ##OEROOT##/meta \
  ##OEROOT##/../meta-openembedded/meta-oe \
  ##OEROOT##/../meta-openembedded/meta-networking \
  ##OEROOT##/../meta-openembedded/meta-python \
  ##OEROOT##/../meta-datarespons \
  ##OEROOT##/../meta-bsp-common \
  ##OEROOT##/../meta-connectivity \
  ##OEROOT##/../meta-freescale \
  ##OEROOT##/../meta-imx-evk \
  "
```

## meta-imx-evk/conf/machine/dr-imx8mmevk.conf
```bitbake
require conf/machine/imx8mmevk.conf

MACHINE_FEATURES += "screen"

MACHINE_ESSENTIAL_EXTRA_RRECOMMENDS += "kernel-modules"
MACHINE_EXTRA_RRECOMMENDS += "flash-uboot"

KERNEL_DEVICETREE = "freescale/imx8mm-evk.dtb"
KERNEL_CLASSES += "kernel-fitimage"
KERNEL_IMAGETYPE_forcevariable = "fitImage"
# Build "Image" as well to enable generating fitimages from recipes
KERNEL_ALT_IMAGETYPE = "Image"
IMAGE_FSTYPES = "tar.bz2"
INITRAMFS_FSTYPES = "cpio.gz"
INITRAMFS_MAXSIZE = "512000"

UBOOT_LOADADDRESS ?= "0x40480000"
UBOOT_DTB_LOADADDRESS ?= "0x43000000"

# meta-freescale sets default packages to all images that we don't want
IMAGE_BOOT_FILES = ""

# We don't wan't kernel image included by default in images
RDEPENDS_${KERNEL_PACKAGE_NAME}-base = ""
```

## meta-sdb8000/conf/layer.conf
```bitbake
# We have a conf and classes directory, add to BBPATH
BBPATH .= ":${LAYERDIR}"

# We have a packages directory, add to BBFILES
BBFILES += "${LAYERDIR}/recipes-*/*/*.bb \
            ${LAYERDIR}/recipes-*/*/*.bbappend"

BBFILE_COLLECTIONS += "sdb8000-layer"
BBFILE_PATTERN_sdb8000-layer := "^${LAYERDIR}/"
BBFILE_PRIORITY_sdb8000-layer = "6"

LAYERDEPENDS_sdb8000-layer = "core freescale-layer bsp-common-layer"
LAYERSERIES_COMPAT_sdb8000-layer = "scarthgap"

# Let us add layer-specific bbappends which are only applied when that
# layer is included in our configuration
BBFILES += "${@' '.join('${LAYERDIR}/%s/recipes*/*/*.bbappend' % layer \
               for layer in BBFILE_COLLECTIONS.split())}"
               
```

## meta-sdb8000/conf/machine/sdb8000.conf
```bitbake
#@TYPE: Machine
#@NAME: SDB8000
#@SOC: i.MX8MM
#@DESCRIPTION: Data Respons sdb8000 board

IMX_DEFAULT_BSP = "mainline"
MACHINEOVERRIDES =. "mx8:mx8m:mx8mm:"

require conf/machine/include/imx-base.inc
require conf/machine/include/arm/armv8a/tune-cortexa53.inc

# Needed to build kernel
UBOOT_MACHINE ??= "sdb8000"
# Kernel fit image addresses
UBOOT_LOADADDRESS:forcevariable = "0x40600000"
UBOOT_ENTRYPOINT:forcevariable = "0x40600000"
UBOOT_DTB_LOADADDRESS:forcevariable = "0x43000000"

MACHINE_FEATURES += "pci wifi bluetooth screen"

MACHINE_ESSENTIAL_EXTRA_RRECOMMENDS += "kernel-modules kernel-module-vmcu linux-firmware-sd8997"
MACHINE_EXTRA_RRECOMMENDS += "udev-rules"

KERNEL_DEVICETREE = "freescale/sdb8000.dtb freescale/vdt8007.dtb freescale/vdt8010.dtb"
KERNEL_IMAGETYPE:forcevariable = "Image"
PREFERRED_PROVIDER_virtual/kernel = "linux-dr"
IMAGE_FSTYPES = "tar.bz2"
INITRAMFS_FSTYPES = "cpio.gz"
INITRAMFS_MAXSIZE = "512000"

# Serial console defined by devicetree. Set variable to empty string to disable default ttyS0. 
SERIAL_CONSOLES = ""

# meta-freescale sets default packages to all images that we don't want
IMAGE_BOOT_FILES = ""

# We don't wan't kernel image included by default in images
RRECOMMENDS:${KERNEL_PACKAGE_NAME}-base = ""

# Vivante only supports fdo backend
PREFERRED_PROVIDER_virtual/wpebackend = "wpebackend-fdo"

# Nvram configuration
NVRAM_INTERFACE_DEFAULT = "mtd"
PACKAGECONFIG:pn-nvram = "format_v2 format_platform interface_mtd interface_file"

# Hostname
NVRAM_HOSTNAME = "datarespons"

# Override pendrive partition default gpt label to stay
# backwards compatible with this projects
# external tools and instructions.
PENDRIVE_PARTLABEL = "TESTDRIVE"
```
